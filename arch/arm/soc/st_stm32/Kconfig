## arch/arm/soc/st_stm32/Kconfig
```kconfig
# Kconfig - ST STM32 family SOC configuration options

#
# Copyright (c) 2016 Intel Corporation.
#
# Licensed under the Apache License, Version 2.0 (the "License");
# you may not use this file except in compliance with the License.
# You may obtain a copy of the License at
#
#     http://www.apache.org/licenses/LICENSE-2.0
#
# Unless required by applicable law or agreed to in writing, software
# distributed under the License is distributed on an "AS IS" BASIS,
# WITHOUT WARRANTIES OR CONDITIONS OF ANY KIND, either express or implied.
# See the License for the specific language governing permissions and
# limitations under the License.
#

config SOC_ST_STM32F2XX
	bool
	default n
	
config SOC_ST_STM32F4XX
	bool
	default n
	
if SOC_ST_STM32F2XX

config SOC
	default st_stm32
	
config NUM_IRQS
	int
	default 140

config SRAM_SIZE
	default 128

config FLASH_SIZE
	default 1024

config FSMC_REGISTER_BASE_ADDRESS
        hex
        default 0xA0000000
        help
        This is the memory address for the Flexlible Static Memory Controller
        (FSMC) registers.
	
endif #SOC_ST_STM32F2XX

if SOC_ST_STM32F4XX

config SOC
	default st_stm32

config NUM_IRQS
	int
	default 140

config SRAM_SIZE
	default 128

config FLASH_SIZE
	default 512

config FSMC_REGISTER_BASE_ADDRESS
        hex
        default 0xA0000000
        help
        This is the memory address for the Flexlible Static Memory Controller
        (FSMC) registers.
	
endif #SOC_ST_STM32F4XX
	
	
config SOC_ST_STM32_CLOCK_HSI
	bool
	default y
	
config NUM_IRQ_PRIO_BITS
	int
	default 3

config SYS_CLOCK_HW_CYCLES_PER_SEC
	int
	default 84000000

config SRAM_BASE_ADDRESS
	default 0x20000000

config FLASH_BASE_ADDRESS
	default 0x08000000

config PERIPHERIAL_BASE_ADDRESS
        hex
        default 0x40000000
        help
        The memory address for the Peripherial register location.

config VECTOR_TABLE_IN_SRAM
        bool
        default false
        help
        If you need to relocate the vector table to internal SRAM, set this
        value to true.

choice
        prompt "Select the clock source for the PLL"
        default SOC_ST_STM32_CLOCK_HSE
        depends on SOC_ST_STM32

config SOC_ST_STM32_CLOCK_HSE
        bool "Use the High Speed External clock signal (HSE)"

config SOC_ST_STM32_CLOCK_HSI
        bool "Use the High Speed Internal clock signal (HSI)"

endchoice

config KERNEL_INIT_PRIORITY_DEFAULT
	default 40

config KERNEL_INIT_PRIORITY_DEVICE
	default 50

#
# Parse through the various supported SOCs to override any values here
#
source "arch/arm/soc/stm32/Kconfig.soc.stm32f2xx*"
source "arch/arm/soc/stm32/Kconfig.soc.stm32f4xx*"
```

## arch/arm/soc/st_stm32/Kconfig.soc
```kconfig
config SOC_STM_STM32F2XX
	bool "ST STM32F2xx Processor"
	select CPU_CORTEX_M
	select CPU_CORTEX_M3


config SOC_ST_STM32F466RE
	bool "ST STM32F466RE Processor"
	select CPU_CORTEX_M
	select CPU_CORTEX_M4
	select SOC_ST_STM32F4XX
```

## boards/nucleo_446re/Kconfig
```kconfig
if BOARD_NUCLEO_446RE

config BOARD
        default nucleo_446re

endif # BOARD_NUCLEO_446RE 
```

## boards/nucleo_446re/Kconfig.board
```kconfig
config  BOARD_NUCLEO_446RE
        bool "ST NUCLEO-446RE Board"
        select SOC_ST_STM32F4XX
	depends on ARM
```

## boards/nucleo_446re/nucleo_446re_defconfig
```kconfig
CONFIG_ARM=y
CONFIG_BOARD_NUCLEO_446RE=y
CONFIG_SOC_STM32F466RE=y
CONFIG_SOC_STM32F4XX=y
CONFIG_SOC_ST_STM32_CLOCK_HSI=y
CONFIG_CORTEX_M_SYSTICK=y
```

## boards/nucleo_f446re/Kconfig
```kconfig
if BOARD_NUCLEO_F446RE

config BOARD
        default nucleo_f446re

config SOC_ST_STM32_CLOCK_HSI
       bool
       default y

endif # BOARD_NUCLEO_F446RE 
```

## boards/nucleo_f446re/Kconfig.board
```kconfig
config  BOARD_NUCLEO_F446RE
        bool "ST NUCLEO-F446RE Board"
        select SOC_ST_STM32F4XX
	depends on ARM
```

## boards/nucleo_f446re/nucleo_f446re_defconfig
```kconfig
CONFIG_ARM=y
CONFIG_BOARD_NUCLEO_F446RE=y
CONFIG_SOC_STM32F466RE=y
CONFIG_SOC_STM32F4XX=y
CONFIG_SOC_ST_STM32_CLOCK_HSI=y
CONFIG_CORTEX_M_SYSTICK=y
```
